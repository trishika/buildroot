## configs/dns320l_defconfig
```kconfig
BR2_arm=y
BR2_CCACHE=y
BR2_TOOLCHAIN_BUILDROOT_GLIBC=y
BR2_BINUTILS_VERSION_2_28_X=y
BR2_TOOLCHAIN_BUILDROOT_CXX=y
BR2_GCC_ENABLE_LTO=y
BR2_TARGET_OPTIMIZATION="-pipe"
BR2_TARGET_GENERIC_HOSTNAME="skinner"
BR2_TARGET_GENERIC_ISSUE="Welcome to skinner"
BR2_TARGET_GENERIC_PASSWD_SHA512=y
BR2_INIT_SYSTEMD=y
BR2_TARGET_GENERIC_ROOT_PASSWD="gnupower"
BR2_SYSTEM_BIN_SH_BASH=y
BR2_TARGET_GENERIC_GETTY_PORT="ttyS0"
BR2_TARGET_GENERIC_GETTY_BAUDRATE_115200=y
BR2_ENABLE_LOCALE_WHITELIST="C en_US fr"
BR2_TARGET_LOCALTIME="Europe/Paris"
BR2_ROOTFS_USERS_TABLES="board/trishika/dns320l/aurelien_user"
BR2_ROOTFS_OVERLAY="board/trishika/dns320l/rootfs_overlay"
BR2_LINUX_KERNEL=y
BR2_LINUX_KERNEL_PATCH="board/trishika/dns320l/linux.patch"
BR2_LINUX_KERNEL_USE_CUSTOM_CONFIG=y
BR2_LINUX_KERNEL_CUSTOM_CONFIG_FILE="board/trishika/dns320l/linux.config"
BR2_LINUX_KERNEL_APPENDED_UIMAGE=y
BR2_LINUX_KERNEL_UIMAGE_LOADADDR="0x00008000"
BR2_LINUX_KERNEL_INTREE_DTS_NAME="kirkwood-dns320l"
BR2_PACKAGE_BUSYBOX_CONFIG="board/trishika/dns320l/busybox.config"
BR2_PACKAGE_BZIP2=y
BR2_PACKAGE_GZIP=y
BR2_PACKAGE_XZ=y
BR2_PACKAGE_GIT=y
BR2_PACKAGE_E2FSPROGS=y
BR2_PACKAGE_ECRYPTFS_UTILS=y
BR2_PACKAGE_MTD=y
BR2_PACKAGE_MTD_MKFSUBIFS=y
BR2_PACKAGE_NFS_UTILS=y
BR2_PACKAGE_FAN_CTRL=y
BR2_PACKAGE_GPTFDISK=y
BR2_PACKAGE_GPTFDISK_GDISK=y
BR2_PACKAGE_GPTFDISK_SGDISK=y
BR2_PACKAGE_HDPARM=y
BR2_PACKAGE_IOSTAT=y
BR2_PACKAGE_LM_SENSORS=y
BR2_PACKAGE_LM_SENSORS_FANCONTROL=y
BR2_PACKAGE_MDADM=y
BR2_PACKAGE_PYTHON=y
BR2_PACKAGE_PYTHON_SERIAL=y
BR2_PACKAGE_RUBY=y
BR2_PACKAGE_CURL=y
BR2_PACKAGE_PCRE_UCP=y
BR2_PACKAGE_BWM_NG=y
BR2_PACKAGE_IPROUTE2=y
BR2_PACKAGE_NGINX=y
BR2_PACKAGE_NGINX_HTTP_XSLT_MODULE=y
BR2_PACKAGE_OPENSSH=y
BR2_PACKAGE_RSYNC=y
BR2_PACKAGE_TRANSMISSION=y
BR2_PACKAGE_TRANSMISSION_CLI=y
BR2_PACKAGE_TRANSMISSION_DAEMON=y
BR2_PACKAGE_WGET=y
BR2_PACKAGE_SUDO=y
BR2_PACKAGE_TMUX=y
BR2_PACKAGE_ATTR=y
BR2_PACKAGE_HTOP=y
BR2_PACKAGE_LXC=y
BR2_PACKAGE_VIM=y
BR2_TARGET_ROOTFS_UBIFS=y
```

## package/libnfsidmap/Config.in
```kconfig
comment "libnfsidmap needs a toolchain w/ threads"
	depends on BR2_USE_MMU
	depends on !(BR2_TOOLCHAIN_HAS_THREADS || BR2_TOOLCHAIN_HAS_NATIVE_RPC)

config BR2_PACKAGE_LIBNFSIDMAP
	bool "libnfsidmap"
	depends on BR2_TOOLCHAIN_HAS_NATIVE_RPC || BR2_TOOLCHAIN_HAS_THREADS # libtirpc
	select BR2_PACKAGE_LIBTIRPC if !BR2_TOOLCHAIN_HAS_NATIVE_RPC
	help
	  The NFS idmap library

	  http://www.citi.umich.edu/projects/nfsv4/linux/
```
